## samples/device_commands/Kconfig.sysbuild
```kconfig
#
# Copyright (c) 2026 Conexio Technologies, Inc
#
# SPDX-License-Identifier: Apache-2.0
#

config PARTITION_MANAGER
	default n

source "share/sysbuild/Kconfig"
```
