## prj.conf
```kconfig
# =============================================================================
# Cellular Location — cell-based device positioning
# =============================================================================
CONFIG_CONEXIO_CLOUD=y

# CBOR binary encoding
CONFIG_CONEXIO_CLOUD_CBOR=y
CONFIG_CONEXIO_CLOUD_CBOR_BUFFER_SIZE=512

# Retry
CONFIG_CONEXIO_CLOUD_RETRY=y

# Cellular location — enables AT%NCELLMEAS module
CONFIG_CELL_LOCATION=y

# How often to trigger a cell measurement (independent of telemetry interval)
# 3600 = 1 fix per hour; use 28800 (8h) for production
CONFIG_CELL_LOCATION_INTERVAL_SEC=3600

# Search type: 0=fast/coarse, 1=moderate (default), 2=thorough/most accurate
# CONFIG_CELL_LOCATION_SEARCH_TYPE=1

# Publish telemetry immediately after a location fix
CONFIG_CELL_LOCATION_PUBLISH_ON_FIX=y

# C library / system
CONFIG_POSIX_THREADS=y
CONFIG_MODEM_INFO_ADD_NETWORK=y
CONFIG_MODEM_INFO_ADD_DEVICE=y
CONFIG_MAIN_STACK_SIZE=4096
CONFIG_HEAP_MEM_POOL_SIZE=65536
CONFIG_SYSTEM_WORKQUEUE_STACK_SIZE=4096
CONFIG_CONEXIO_CLOUD_THREAD_STACK_SIZE=4096
CONFIG_LOG=y
CONFIG_LOG_DEFAULT_LEVEL=3
CONFIG_UART_CONSOLE=y
CONFIG_RESET_ON_FATAL_ERROR=y

# TF-M minimal profile (required for bootloader partition layout)
CONFIG_TFM_PROFILE_TYPE_MINIMAL=y
```

## src/main.c
```c
/*
 * Copyright (c) 2026 Conexio Technologies, Inc.
 *
 * SPDX-License-Identifier: Apache-2.0
 */

/*
 * cellular_location/src/main.c — Cell-based location sample.
 *
 * Demonstrates gathering neighboring cell measurements and
 * streaming them to the Conexio Cloud for server-side positioning.
 */

#include <conexio_cloud/conexio_cloud.h>
#include <conexio_cloud/cell_location.h>
#include <zephyr/kernel.h>
#include <zephyr/logging/log.h>

#if __has_include(<app_version.h>)
#  include <app_version.h>
#else
#  define APP_VERSION_STRING "1.0.0"
#endif

LOG_MODULE_REGISTER(app, LOG_LEVEL_INF);

/* ── Cloud event handler ────────────────────────────────────────────────── */
static void on_cloud_event(const struct conexio_cloud_event *evt)
{
    switch (evt->type) {
    case CONEXIO_CLOUD_EVT_CONNECTED:
        LOG_INF("Connected — %s | App v%s",
                conexio_cloud_device_id(), APP_VERSION_STRING);
        break;
    case CONEXIO_CLOUD_EVT_DISCONNECTED:
        LOG_WRN("Disconnected");
        break;
    case CONEXIO_CLOUD_EVT_ERROR:
        LOG_ERR("Cloud error: %d", evt->data.error);
        break;
    default:
        break;
    }
}

/* ── main ─────────────────────────────────────────────────────────────── */
int main(void)
{
    LOG_INF("=== Conexio Cellular Location Sample ===");
    LOG_INF("Fix interval: %ds | Publish on fix: %s",
            CONFIG_CELL_LOCATION_INTERVAL_SEC,
            IS_ENABLED(CONFIG_CELL_LOCATION_PUBLISH_ON_FIX) ? "yes" : "no");

    int ret = conexio_cloud_init(on_cloud_event);
    if (ret) { LOG_ERR("init failed (%d)", ret); return -1; }

    LOG_INF("Connecting...");
    if (conexio_cloud_wait_connected(60000) == 0) {
        k_sleep(K_SECONDS(2));
        conexio_cloud_publish();
    }

    /*
     * Initialise the cell location module AFTER LTE is connected.
     * cell_location_init() registers the AT%NCELLMEAS event handler.
     * The first measurement fires automatically after
     * CONFIG_CELL_LOCATION_INTERVAL_SEC seconds via cell_location_tick().
     */
    cell_location_init();
    LOG_INF("Cell location active — first fix in %ds",
            CONFIG_CELL_LOCATION_INTERVAL_SEC);

    /* Main loop — advance the location countdown every 5 seconds */
    while (1) {
        k_sleep(K_SECONDS(5));
        for (int i = 0; i < 5; i++) {
            cell_location_tick();
        }
    }
    return 0;
}
```
